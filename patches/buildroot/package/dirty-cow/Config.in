## patches/buildroot/package/dirty-cow/Config.in
```kconfig
config BR2_PACKAGE_DIRTY_COW
	bool "dirty cow"
	depends on BR2_TOOLCHAIN_HAS_THREADS
	help
	  Dirty COW (CVE-2016-5195) is a privilege escalation
	  vulnerability in the Linux Kernel. A race condition was
	  found in the way the Linux kernel's memory subsystem handled
	  the copy-on-write (COW) breakage of private read-only
	  memory mappings. An unprivileged local user could use
	  this flaw to gain write access to otherwise read-only memory
	  mappings and thus increase their privileges on the system.

	  https://github.com/luarocks/argpars://nvd.nist.gov/vuln/detail/CVE-2016-5195

comment "dirty cow needs a toolchain w/ threads"
	depends on !BR2_TOOLCHAIN_HAS_THREADS
```
