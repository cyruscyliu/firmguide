/dts-v1/;

/ {
    compatible = "test,compatible";
    #address-cells = <0x2>;
    #size-cells = <0x2>;
    soc {
        #address-cells = <0x2>;
        #size-cells = <0x1>;
        compatible = "simple-bus";
        ranges = <
            0xF0010000 0x0 0x0 0xF1000000 0x100000
            0x011D0000 0x0 0x0 0xFFF00000 0x100000
            0x09090000 0x0 0x0 0xF1100000 0x010000
            0x09050000 0x0 0x0 0xF1110000 0x010000
            0x0C040000 0x0 0x0 0xF1200000 0x100000>;
        spi@10600 {
            reg = <
                0xF0010000 0x10600 0x28
                0x011E0000 0x0 0xFFFFFFFF
                0x015E0000 0x0 0xFFFFFFFF
                0x019E0000 0x0 0xFFFFFFFF
                0x01DE0000 0x0 0xFFFFFFFF
                0x011F0000 0x0 0xFFFFFFFF
                0x015F0000 0x0 0xFFFFFFFF
                0x019F0000 0x0 0xFFFFFFFF
                0x01DF0000 0x0 0xFFFFFFFF>;
            #address-cells = <0x1>;
            #size-cells = <0x0>;
            compatible = "test,spi";
        };
    };
};
